## CMakeLists.txt
```
# Built with nRF Connect SDK v3.2.1:
#     west build -b xiao_ble/nrf52840/sense -d C:/gmwm-build/xiao-nrf52840-sense
cmake_minimum_required(VERSION 3.20.0)

# Object paths run about 165 characters past the build folder, and Windows tools fail above 260
set(BUILD_DIR_MAX_LENGTH 90)
string(LENGTH "${CMAKE_BINARY_DIR}" build_dir_length)
if(CMAKE_HOST_WIN32 AND build_dir_length GREATER BUILD_DIR_MAX_LENGTH)
    message(FATAL_ERROR
        "Build folder path is ${build_dir_length} characters:\n"
        "    ${CMAKE_BINARY_DIR}\n"
        "On Windows it must be ${BUILD_DIR_MAX_LENGTH} or fewer, or object file paths pass the 260-character "
        "limit. Build into a short folder instead:\n"
        "    west build -b xiao_ble/nrf52840/sense -d C:/gmwm-build/xiao-nrf52840-sense")
endif()

find_package(Zephyr REQUIRED HINTS $ENV{ZEPHYR_BASE})
project(imu_streamer C)

set(FIRMWARE_COMMON_DIR ${CMAKE_CURRENT_SOURCE_DIR}/../../common)

target_include_directories(app PRIVATE
    ${CMAKE_CURRENT_SOURCE_DIR}/include
    ${FIRMWARE_COMMON_DIR}/stream
)

target_sources(app PRIVATE
    src/main.c
    src/Imu/imu_sampler.c
    src/Imu/lsm6ds3trc.c
    src/Stream/stream_port.c
    ${FIRMWARE_COMMON_DIR}/stream/stream_packet.c
)
```

## prj.conf
```kconfig
# GPIO, the IMU's regulator, and the USB console come from the board's defconfig

# Raw register access; Zephyr's st,lsm6dsl sensor driver stays off
CONFIG_I2C=y
```

## app.overlay
```dts
/*
 * The CDC ACM TX FIFO defaults to 1 KB, and with no flow control a full FIFO
 * drops bytes. 8 KB holds 20 stream packets, so a burst after a slow poll fits.
 */
&board_cdc_acm_uart {
	tx-fifo-size = <8192>;
};
```

## src/main.c
```c
/**
 ******************************************************************************
 * @file    main.c
 * @brief   The data flow, end to end:
 *
 *            LSM6DS3TR-C FIFO --i2c0--> imu sampler --blocks--> stream --USB CDC ACM--> PC
 *
 *          The red LED toggles with every block sent. It stays on when the IMU
 *          could not be set up, and the reason is printed to the same USB port.
 ******************************************************************************
 */
#include "Imu/imu_sampler.h"
#include "stream_packet.h"

#include <zephyr/drivers/gpio.h>
#include <zephyr/kernel.h>
#include <zephyr/sys/printk.h>

static const struct gpio_dt_spec red_led = GPIO_DT_SPEC_GET(DT_ALIAS(led0), gpios);

int main(void)
{
    gpio_pin_configure_dt(&red_led, GPIO_OUTPUT_INACTIVE);

    int err = imu_sampler_start();
    if (err < 0)
    {
        gpio_pin_set_dt(&red_led, 1);
        for (;;)
        {
            /* Repeated, since the PC usually opens the port after boot */
            printk("LSM6DS3TR-C: setup failed (%d)\n", err);
            k_msleep(1000);
        }
    }

    for (;;)
    {
        imu_block_t block;

        /* A failed read is retried at the next poll. One that lost samples restarts the FIFO
         * and skips a seq, so the PC sees it. No printk here: text between packets costs
         * the PC the packet before it. */
        if (imu_sampler_get_block(&block) > 0)
        {
            stream_send(STREAM_SRC_LSM6DS3TRC, block.seq, &block.payload, sizeof(block.payload));
            gpio_pin_toggle_dt(&red_led);
            continue; /* the FIFO may hold another block */
        }
        k_msleep(IMU_POLL_MS);
    }
}
```

## include/app_config.h
```c
/**
 ******************************************************************************
 * @file    app_config.h
 * @brief   Acquisition settings: edit, rebuild, reflash.
 *
 *          Every stream packet carries the CTRL1_XL and CTRL2_G values the IMU
 *          actually runs with, so the PC reads the rate and scales from the data
 *          and nothing here needs copying to MATLAB or Python.
 ******************************************************************************
 */
#ifndef APP_CONFIG_H
#define APP_CONFIG_H

#include "Imu/lsm6ds3trc.h"

/* Gyro, accelerometer, and FIFO sample rate: LSM6_ODR_12_5HZ .. LSM6_ODR_1660HZ.
 * 1.66 kHz uses about half of i2c0's 400 kHz. */
#define IMU_ODR LSM6_ODR_104HZ

/* Full scales: the smallest give the finest resolution, and a static IMU never nears them.
 * 125 dps = 4.375 mdps/LSB and 2 g = 0.061 mg/LSB (datasheet Table 3) */
#define IMU_GYRO_FS  LSM6_FS_G_125DPS
#define IMU_ACCEL_FS LSM6_FS_XL_2G

/* Samples per stream packet: 32 makes a 400-byte packet, about 3 per second at 104 Hz */
#define IMU_FRAMES_PER_BLOCK 32U

/* How often the FIFO is drained. It holds 341 samples: 3.3 s at 104 Hz, 205 ms at 1.66 kHz */
#define IMU_POLL_MS 10U

/* Time from turning the gyro and accelerometer on to the first sample kept, a margin
 * for the gyro's turn-on from power-down */
#define IMU_SETTLE_MS 100U

#endif /* APP_CONFIG_H */
```
